// Generated by scripts/build_daily_quotes.py from English Wikiquote (CC BY-SA).
// Provenance for every record - page, revision id, retrieval time - is in
// docs/daily-quotes-sources.tsv. Do not hand-edit either file.
// Initialiser rows only - DailyQuote.cpp owns the array declaration.
    {"It told Jeremiah and Daniel and Amos and Abraham.", "", "11/22/63", "Stephen King"},
    {"\"Tell me why?\" \"I wear the chain I forged in life,\" replied the Ghost.", "", "A Christmas Carol", "Charles Dickens"},
    {"\"With the breakdown of the Medieval system, the gods of Chaos, Lunacy, and Bad Taste gained ascendancy.\"", "", "A Confederacy of Dunces", "John Kennedy Toole"},
    {"Personal relations are the important thing for ever and ever and not this outer life of telegrams and anger.", "", "A Passage to India", "E. M. Forster"},
    {"You talk to me of nationality, language, religion.", "", "A Portrait of the Artist as a Young Man", "James Joyce"},
    {"I have always depended on the kindness of strangers.", "", "A Streetcar Named Desire", "Tennessee Williams"},
    {"What pastoral response acquits Those who made ovens for Auschwitz?", "", "A Suitable Boy", "Vikram Seth"},
    {"Death is Nature's remedy for all things, and why not Legislation's?", "", "A Tale of Two Cities", "Charles Dickens"},
    {"Just because we don't understand doesn't mean that the explanation doesn't exist.", "", "A Wrinkle in Time", "Madeleine L'Engle"},
    {"\"Will you walk a little faster?\" said a whiting to a snail.", "", "Alice's Adventures in Wonderland", "Lewis Carroll"},
    {"Ideas are more difficult to kill than people, but they can be killed, in the end.", "", "American Gods", "Neil Gaiman"},
    {"“Show a people as one thing, only one thing, over and over again, and that is what they become.”", "", "Americanah", "Chimamanda Ngozi Adichie"},
    {"Much of this work was of a kind that the other animals were too ignorant to understand.", "", "Animal Farm", "George Orwell"},
    {"Happy families are all alike; every unhappy family is unhappy in its own way.", "", "Anna Karenina", "Leo Tolstoy"},
    {"Oh, this is the most tragical thing that has ever happened to me!", "", "Anne of Green Gables", "L. M. Montgomery"},
    {"The Earth does not want new continents, but new men.", "", "Around the World in Eighty Days", "Jules Verne"},
    {"Behaviour that's admired is the path to power among people everywhere.", "", "Beowulf", "Anonymous"},
    {"The one great principle of the English law is to make business for itself.", "", "Bleak House", "Charles Dickens"},
    {"He never sleeps, the judge. He is dancing, dancing. He says that he will never die.", "", "Blood Meridian", "Cormac McCarthy"},
    {"In a properly organized society like ours, nobody has any opportunities for being noble or heroic.", "", "Brave New World", "Aldous Huxley"},
    {"To know and love one other human being is the root of all wisdom.", "", "Brideshead Revisited", "Evelyn Waugh"},
    {"\"Excellently observed,\" answered Candide; \"but let us cultivate our garden.\"", "", "Candide", "Voltaire"},
    {"“She said his mind was turned to the biggest music there was, the music of the stars.”", "", "Cat's Cradle", "Kurt Vonnegut"},
    {"\"That's some catch, that Catch-22,\" he observed. \"It's the best there is,\" Doc Daneeka agreed.", "", "Catch-22", "Joseph Heller"},
    {"After all, what's a life, anyway? We're born, we live a little while, we die.", "", "Charlotte's Web", "E. B. White"},
    {"Books don't offer real escape but they can stop a mind scratching itself raw.", "", "Cloud Atlas", "David Mitchell"},
    {"To go wrong in one's own way is better than to go right in someone else's.", "", "Crime and Punishment", "Fyodor Dostoevsky"},
    {"Annual income twenty pounds, annual expenditure nineteen nineteen and six, result happiness.", "", "David Copperfield", "Charles Dickens"},
    {"I frequently see literary men; I'm on a very friendly footing with Pushkin.", "", "Dead Souls", "Nikolai Gogol"},
    {"Attention, attention must be finally paid to such a person.", "", "Death of a Salesman", "Arthur Miller"},
    {"Come, Death, and snatch me from disgrace.", "", "Disgrace", "J. M. Coetzee"},
    {"Not the aesthetic capacity but the capacity for indignation.", "", "Do Androids Dream of Electric Sheep?", "Philip K. Dick"},
    {"Finally, from so little sleeping and so much reading, his brain dried up and he went completely out of his mind.", "", "Don Quixote", "Miguel de Cervantes"},
    {"I must not fear. Fear is the mind-killer. Fear is the little-death that brings total obliteration...", "", "Dune", "Frank Herbert"},
    {"It is always attacked and never destroyed — because Thou mayest.", "", "East of Eden", "John Steinbeck"},
    {"One half of the world cannot understand the pleasures of the other.", "", "Emma", "Jane Austen"},
    {"“The essence of training is to allow error without consequence.”", "", "Ender's Game", "Orson Scott Card"},
    {"Everyone must leave something behind when he dies, my grandfather said.", "", "Fahrenheit 451", "Ray Bradbury"},
    {"You are not a beautiful and unique snowflake.", "", "Fight Club", "Chuck Palahniuk"},
    {"The people who have brains and courage come through and the ones who haven't are winnowed out.", "", "Gone with the Wind", "Margaret Mitchell"},
    {"It wasn't a dark and stormy night. It should have been, but that's the weather for you.", "", "Good Omens", "Terry Pratchett and Neil Gaiman"},
    {"Pip, dear old chap, life is made of ever so many partings welded together...", "", "Great Expectations", "Charles Dickens"},
    {"I wrote for their amendment, and not their approbation.", "", "Gulliver's Travels", "Jonathan Swift"},
    {"This was love: a string of coincidences that gathered significance and became miracles.", "", "Half of a Yellow Sun", "Chimamanda Ngozi Adichie"},
    {"Hamlet Then I would you were so honest a man.", "", "Hamlet", "William Shakespeare"},
    {"To the well-organized mind, death is but the next great adventure.", "", "Harry Potter and the Philosopher's Stone", "J. K. Rowling"},
    {"I solemnly swear that I am up to no good.", "", "Harry Potter and the Prisoner of Azkaban", "J. K. Rowling"},
    {"I don't like work — no man does — but I like what is in work — the chance to find yourself.", "", "Heart of Darkness", "Joseph Conrad"},
    {"Human beings can’t see anything without wanting to destroy it, Lyra. That’s original sin.", "", "His Dark Materials", "Philip Pullman"},
    {"It's not my fault if I live and breathe, Eat, drink, sleep and put on clothes.", "", "If This Is a Man", "Primo Levi"},
    {"I am invisible, understand, simply because people refuse to see me.", "", "Invisible Man", "Ralph Ellison"},
    {"She had never dreamed there could be so much pain in a life when there was nothing physically wrong.", "", "It", "Stephen King"},
    {"Conventionality is not morality. Self-righteousness is not religion. To attack the first is not to assail the last.", "", "Jane Eyre", "Charlotte Brontë"},
    {"Sometimes fate is like a small sandstorm that keeps changing directions.", "", "Kafka on the Shore", "Haruki Murakami"},
    {"Truth's a dog must to kennel; he must be whipped out, when Lady the brach may stand by the fire and stink.", "", "King Lear", "William Shakespeare"},
    {"Seeing, hearing, feeling, are miracles, and each part and tag of me is a miracle.", "", "Leaves of Grass", "Walt Whitman"},
    {"I must say a word about fear. It is life's only true opponent. Only fear can defeat life.", "", "Life of Pi", "Yann Martel"},
    {"I'm not afraid of storms, for I'm learning how to sail my ship.", "", "Little Women", "Louisa May Alcott"},
    {"Lolita, light of my life, fire of my loins. My sin, my soul.", "", "Lolita", "Vladimir Nabokov"},
    {"There is nothing more enticing, disenchanting, and enslaving than the life at sea.", "", "Lord Jim", "Joseph Conrad"},
    {"It seems to me that we do live in two worlds.", "", "Lord of the Flies", "William Golding"},
    {"Florentino Ariza pensaba que sólo el terror peodía inducir a semejante indignidad.", "", "Love in the Time of Cholera", "Gabriel García Márquez"},
    {"Stand not upon the order of your going, But go at once.", "", "Macbeth", "William Shakespeare"},
    {"We shouldn't maltreat our idols: the gilt comes off on our hands.", "", "Madame Bovary", "Gustave Flaubert"},
    {"There are two tragedies in life. One is not to get your heart's desire. The other is to get it.", "", "Man and Superman", "George Bernard Shaw"},
    {"It is not down on any map; true places never are.", "", "Moby-Dick", "Herman Melville"},
    {"History always has a few tricks up its frayed sleeve. It's been around a long time.", "", "Mort", "Terry Pratchett"},
    {"The sky above the port was the color of television, tuned to a dead channel.", "", "Neuromancer", "William Gibson"},
    {"It was a bright cold day in April, and the clocks were striking thirteen.", "", "Nineteen Eighty-Four", "George Orwell"},
    {"Books ain't no good. A guy needs somebody — to be near him. A guy goes nuts if he ain't got nobody.", "", "Of Mice and Men", "John Steinbeck"},
    {"Dead men never repent; dead men never bring awkward stories to light.", "", "Oliver Twist", "Charles Dickens"},
    {"Our battered suitcases were piled on the sidewalk again; we had longer ways to go. But no matter, the road is life.", "", "On the Road", "Jack Kerouac"},
    {"The world was so recent that many things lacked names, and in order to indicate them it was necessary to point.", "", "One Hundred Years of Solitude", "Gabriel García Márquez"},
    {"Why then drag in such irrelevant matters as wasted dollars and power politics?", "", "Pale Fire", "Vladimir Nabokov"},
    {"The mind is its own place, and in itself Can make a heav'n of hell, a hell of heav'n.", "", "Paradise Lost", "John Milton"},
    {"The State is the curse of the individual.", "", "Peer Gynt", "Henrik Ibsen"},
    {"To die will be an awfully big adventure.", "", "Peter Pan", "J. M. Barrie"},
    {"She is tolerable; but not handsome enough to tempt me.", "", "Pride and Prejudice", "Jane Austen"},
    {"Titles are shadows, crowns are empty things, The good of subjects is the end of kings.", "", "Robinson Crusoe", "Daniel Defoe"},
    {"Nay, sit, nay, sit, good cousin Capulet; For you and I are past our dancing days.", "", "Romeo and Juliet", "William Shakespeare"},
    {"Know your own happiness. You want nothing but patience; or give it a more fascinating name: call it hope.", "", "Sense and Sensibility", "Jane Austen"},
    {"Listen: Billy Pilgrim has come unstuck in time.", "", "Slaughterhouse-Five", "Kurt Vonnegut"},
    {"Every organization needs at least one person who knows what’s going on, and why it’s happening, and who’s doing it.", "", "Small Gods", "Terry Pratchett"},
    {"When you are wrestling for possession of a sword, the man with the handle always wins.", "", "Snow Crash", "Neal Stephenson"},
    {"Solitude is independence. It had been my wish and with the years I had attained it. It was cold.", "", "Steppenwolf", "Hermann Hesse"},
    {"Love is that condition in which the happiness of another person is essential to your own.", "", "Stranger in a Strange Land", "Robert A. Heinlein"},
    {"The Tao that can be described is not the enduring and unchanging Tao.", "", "Tao Te Ching", "Laozi"},
    {"I don’t ask you to love me always like this, but I ask you to remember.", "", "Tender Is the Night", "F. Scott Fitzgerald"},
    {"I studied a minute, sort of holding my breath, and then says to myself, \"All right, then, I'll go to hell.\"", "", "The Adventures of Huckleberry Finn", "Mark Twain"},
    {"He was not the Model Boy of the village. He knew the model boy very well though—and loathed him.", "", "The Adventures of Tom Sawyer", "Mark Twain"},
    {"When you want something, all the universe conspires in helping you to achieve it.", "", "The Alchemist", "Paulo Coelho"},
    {"To subdue the enemy without fighting is the acme of skill.", "", "The Art of War", "Sun Tzu"},
    {"I thought how strange it had never occurred to me before that I was only purely happy until I was nine years old.", "", "The Bell Jar", "Sylvia Plath"},
    {"Here is a small fact: You are going to die.", "", "The Book Thief", "Markus Zusak"},
    {"He was a verray, parfit gentil knyght. He was a very perfect, gentle knight.", "", "The Canterbury Tales", "Geoffrey Chaucer"},
    {"Don't ever tell anybody anything. If you do, you start missing everybody.", "", "The Catcher in the Rye", "J. D. Salinger"},
    {"Once a King or Queen in Narnia, always a King or Queen.", "", "The Chronicles of Narnia", "C. S. Lewis"},
    {"We must have felt what it is to die, Morrel, that we may appreciate the enjoyments of life.", "", "The Count of Monte Cristo", "Alexandre Dumas"},
    {"I keep my ideals, because in spite of everything I still believe that people are really good at heart.", "", "The Diary of a Young Girl", "Anne Frank"},
    {"He brings this across the bridge between the dream-time and the world-time.", "", "The Dispossessed", "Ursula K. Le Guin"},
    {"Per me si va ne la città dolente, per me si va ne l'etterno dolore, per me si va tra la perduta gente.", "", "The Divine Comedy", "Dante Alighieri"},
    {"We are the real countries, not the boundaries drawn on maps with the names of powerful men.", "", "The English Patient", "Michael Ondaatje"},
    {"I fell in love with him the way you fall asleep: Slowly, and then all at once.", "", "The Fault in Our Stars", "John Green"},
    {"The worst part of holding the memories is not the pain. It's the loneliness of it. Memories need to be shared.", "", "The Giver", "Lois Lowry"},
    {"They considered their Games a path from Becoming to Being, from potentiality to reality.", "", "The Glass Bead Game", "Hermann Hesse"},
    {"Boundaries blur as tapioca fences take root and bloom.", "", "The God of Small Things", "Arundhati Roy"},
    {"In the souls of the people the grapes of wrath are filling and growing heavy, growing heavy for the vintage.", "", "The Grapes of Wrath", "John Steinbeck"},
    {"Eckleburg, which had just emerged, pale and enormous, from the dissolving night.", "", "The Great Gatsby", "F. Scott Fitzgerald"},
    {"Apathetic bloody planet, I've no sympathy at all.", "", "The Hitchhiker's Guide to the Galaxy", "Douglas Adams"},
    {"Thief, thief, thief! Baggins! We hates it, we hates it, we hates it for ever!", "", "The Hobbit", "J. R. R. Tolkien"},
    {"Quand on voulut le détacher du squelette qu'il embrassait, il tomba en poussière.", "", "The Hunchback of Notre-Dame", "Victor Hugo"},
    {"I wish I could freeze this moment, right here, right now, and live in it forever.", "", "The Hunger Games", "Suzanne Collins"},
    {"A man's heart is a wretched, wretched thing.", "", "The Kite Runner", "Khaled Hosseini"},
    {"Things will have to change in order that they remain the same.", "", "The Leopard", "Giuseppe Tomasi di Lampedusa"},
    {"Though the Witch knew the Deep Magic, there is a magic deeper still which she did not know...", "", "The Lion, the Witch and the Wardrobe", "C. S. Lewis"},
    {"It is only with the heart that one can see rightly; What is essential is invisible to the eye.", "", "The Little Prince", "Antoine de Saint-Exupéry"},
    {"Endlessly imitated, it never has been surpassed.", "", "The Lord of the Rings", "J. R. R. Tolkien"},
    {"We Earth Men have a talent for ruining big, beautiful things.", "", "The Martian Chronicles", "Ray Bradbury"},
    {"I am the Water of Life, Out of myself I grow. The more you drink of me, The fuller I will flow.", "", "The Neverending Story", "Michael Ende"},
    {"Don't look for gods in men; you'll always be disappointed.", "", "The Odyssey", "Homer"},
    {"\"Castor and Pollux blow me to Bermuda!\" he exclaimed, and immediately vanished with a frightful roar.", "", "The Once and Future King", "T. H. White"},
    {"“Charlie, we accept the love we think we deserve.”", "", "The Perks of Being a Wallflower", "Stephen Chbosky"},
    {"Expect everything, I always say, and the unexpected never happens.", "", "The Phantom Tollbooth", "Norton Juster"},
    {"There is no such thing as a moral or an immoral book. Books are well written, or badly written. That is all.", "", "The Picture of Dorian Gray", "Oscar Wilde"},
    {"The wrongdoing of one generation lives into the successive ones...", "", "The Scarlet Letter", "Nathaniel Hawthorne"},
    {"If you look the right way, you can see that the whole world is a garden.", "", "The Secret Garden", "Frances Hodgson Burnett"},
    {"Few things leave a deeper mark on a reader than the first book that finds its way into his heart.", "", "The Shadow of the Wind", "Carlos Ruiz Zafón"},
    {"I am indeed but a wanderer, a pilgrim on earth. But are you anything more?", "", "The Sorrows of Young Werther", "Johann Wolfgang von Goethe"},
    {"The fuses were not the same as the ones Trash had rigged to the fuel trucks, but they were very similar.", "", "The Stand", "Stephen King"},
    {"I have finally realized how rarely you will find a flawless woman, one who is simply perfect.", "", "The Tale of Genji", "Murasaki Shikibu"},
    {"We are such stuff As dreams are made on; and our little life Is rounded with a sleep.", "", "The Tempest", "William Shakespeare"},
    {"Strength is the outcome of need; security sets a premium on feebleness.", "", "The Time Machine", "H. G. Wells"},
    {"The past is but the beginning of a beginning, and all that is or has been is but the twilight of the dawn.", "", "The War of the Worlds", "H. G. Wells"},
    {"There is nothing — absolutely nothing — half so much worth doing as simply messing about in boats.", "", "The Wind in the Willows", "Kenneth Grahame"},
    {"Until the lions have their own historians, the history of the hunt will always glorify the hunter.", "", "Things Fall Apart", "Chinua Achebe"},
    {"\"That's the way it's done,\" the Queen said with great decision: \"nobody can do two things at once, you know.\"", "", "Through the Looking-Glass", "Lewis Carroll"},
    {"Fifteen men on the dead man's chest — Yo-ho-ho, and a bottle of rum!", "", "Treasure Island", "Robert Louis Stevenson"},
    {"I am all the daughters of my father's house, And all the brothers too.", "", "Twelfth Night", "William Shakespeare"},
    {"History, Stephen said, is a nightmare from which I am trying to awake.", "", "Ulysses", "James Joyce"},
    {"The world is a looking-glass, and gives back to every man the reflection of his own face.", "", "Vanity Fair", "William Makepeace Thackeray"},
    {"Ever tried. Ever failed. No matter. Try again. Fail again. Fail better.", "", "Waiting for Godot", "Samuel Beckett"},
    {"The mass of men lead lives of quiet desperation. What is called resignation is confirmed desperation.", "", "Walden", "Henry David Thoreau"},
    {"Unless you wish to use such drastic measures, you must find a way of settling your disputes without resort to arms.", "", "War and Peace", "Leo Tolstoy"},
    {"Happiness isn't always the best way to be happy.", "", "Where the Wild Things Are", "Maurice Sendak"},
    {"Cottleston, cottleston, cottleston pie, A fly can't bird, but a bird can fly.", "", "Winnie-the-Pooh", "A. A. Milne"},
    {"My love for Heathcliff resembles the eternal rocks beneath: a source of little visible delight, but necessary.", "", "Wuthering Heights", "Emily Brontë"},
    {"Every man has his folly, but the greatest folly of all ... is not to have one.", "", "Zorba the Greek", "Nikos Kazantzakis"},
    {"The other three percent are people who do what they say they can do.", "", "11/22/63", "Stephen King"},
    {"When Fortuna spins you downward, go out to a movie and get more out of life.", "", "A Confederacy of Dunces", "John Kennedy Toole"},
    {"Only connect the prose and the passion, and both will be exalted, and human love will be seen at its height.", "", "A Passage to India", "E. M. Forster"},
    {"His mind, emptied of theory and courage, lapsed back into a listless peace.", "", "A Portrait of the Artist as a Young Man", "James Joyce"},
    {"Physical beauty is passing - a transitory possession.", "", "A Streetcar Named Desire", "Tennessee Williams"},
    {"The wedding-guests were gathered on the lawn. 'Hmm,' she said.", "", "A Suitable Boy", "Vikram Seth"},
    {"Maybe you have to know darkness before you can appreciate the light.", "", "A Wrinkle in Time", "Madeleine L'Engle"},
    {"If you drink much from a bottle marked 'poison' it is almost certain to disagree with you, sooner or later.", "", "Alice's Adventures in Wonderland", "Lewis Carroll"},
    {"If Hell is other people, thought Shadow, then Purgatory is airports.", "", "American Gods", "Neil Gaiman"},
    {"Culture does not make people, people make culture.", "", "Americanah", "Chimamanda Ngozi Adichie"},
    {"Man is the only creature that consumes without producing.", "", "Animal Farm", "George Orwell"},
    {"If goodness has causes, it is not goodness; if it has effects, a reward, it is not goodness either.", "", "Anna Karenina", "Leo Tolstoy"},
    {"“You mean, hateful boy!” she exclaimed passionately.", "", "Anne of Green Gables", "L. M. Montgomery"},
    {"Poets are like proverbs: you can always find one to contradict another.", "", "Around the World in Eighty Days", "Jules Verne"},
    {"Down off the moorlands' misting fells came Grendel stalking; God's brand was on him.", "", "Beowulf", "Anonymous"},
    {"You can find meanness in the least of creatures, but when God made man the devil was at his elbow.", "", "Blood Meridian", "Cormac McCarthy"},
    {"Liberty to be inefficient and miserable.", "", "Brave New World", "Aldous Huxley"},
    {"My theme is memory, that winged host that soared about me one grey morning of war-time.", "", "Brideshead Revisited", "Evelyn Waugh"},
    {"If this is the best of all possible worlds, what are the others?", "", "Candide", "Voltaire"},
    {"All of the true things that I am about to tell you are shameless lies.", "", "Cat's Cradle", "Kurt Vonnegut"},
    {"It was love at first sight. The first time Yossarian saw the chaplain, he fell madly in love with him.", "", "Catch-22", "Joseph Heller"},
    {"People believe almost anything they see in print.", "", "Charlotte's Web", "E. B. White"},
    {"Truth is singular. Its 'versions' are mistruths.", "", "Cloud Atlas", "David Mitchell"},
    {"You never reach any truth without making fourteen mistakes and very likely a hundred and fourteen.", "", "Crime and Punishment", "Fyodor Dostoevsky"},
    {"There are people who exist in this world not like entities but like the speckles or spots on something.", "", "Dead Souls", "Nikolai Gogol"},
    {"A salesman is got to dream, boy. It comes with the territory.", "", "Death of a Salesman", "Arthur Miller"},
    {"Disgrace is immortal, and living even when one thinks it dead.", "", "Disgrace", "J. M. Coetzee"},
    {"If you're lucky you will get the second; but you can be certain of getting the first: that is the way it works.", "", "Do Androids Dream of Electric Sheep?", "Philip K. Dick"},
    {"Take care, Your Worship, those things over there are not giants but windmills.", "", "Don Quixote", "Miguel de Cervantes"},
    {"Make that the science of your tradition!", "", "Dune", "Frank Herbert"},
    {"This I believe: that the free, exploring mind of the individual human is the most valuable thing in the world.", "", "East of Eden", "John Steinbeck"},
    {"Better be without sense, than misapply it as you do.", "", "Emma", "Jane Austen"},
    {"No one but the enemy will ever teach you how to destroy and conquer.", "", "Ender's Game", "Orson Scott Card"},
    {"If you don't want a man unhappy politically, don't give him two sides to a question to worry him; give him one.", "", "Fahrenheit 451", "Ray Bradbury"},
    {"This is your life, and it's ending one minute at a time.", "", "Fight Club", "Chuck Palahniuk"},
    {"Southerners can never resist a losing cause.", "", "Gone with the Wind", "Margaret Mitchell"},
    {"A butterfly flaps its wings in the Amazonian jungle, and subsequently a storm ravages half of Europe.", "", "Good Omens", "Terry Pratchett and Neil Gaiman"},
    {"For a man may be allowed to keep poisons in his closet, but not to vend them about for cordials.", "", "Gulliver's Travels", "Jonathan Swift"},
    {"You must never behave as if your life belongs to a man.", "", "Half of a Yellow Sun", "Chimamanda Ngozi Adichie"},
    {"It takes a great deal of bravery to stand up to our enemies, but just as much to stand up to our friends.", "", "Harry Potter and the Philosopher's Stone", "J. K. Rowling"},
    {"You think the dead we loved ever truly leave us?", "", "Harry Potter and the Prisoner of Azkaban", "J. K. Rowling"},
    {"The mind of man is capable of anything — because everything is in it, all the past as well as all the future.", "", "Heart of Darkness", "Joseph Conrad"},
    {"You cannot change what you are, only what you do.", "", "His Dark Materials", "Philip Pullman"},
    {"Those who deny Auschwitz would be ready to remake it.", "", "If This Is a Man", "Primo Levi"},
    {"I was looking for myself and asking everyone except myself questions which I, and only I, could answer.", "", "Invisible Man", "Ralph Ellison"},
    {"The human and fallible should not arrogate a power with which the divine and perfect alone can be safely intrusted.", "", "Jane Eyre", "Charlotte Brontë"},
    {"In everybody’s life there’s a point of no return.", "", "Kafka on the Shore", "Haruki Murakami"},
    {"Nothing can happen more beautiful than death.", "", "Leaves of Grass", "Walt Whitman"},
    {"To choose doubt as a philosophy of life is akin to choosing immobility as a means of transportation.", "", "Life of Pi", "Yann Martel"},
    {"\"Christmas won't be Christmas without any presents,\" grumbled Jo, lying on the rug.", "", "Little Women", "Louisa May Alcott"},
    {"Lo-lee-ta: the tip of the tongue taking a trip of three steps down the palate to tap, at three, on the teeth.", "", "Lolita", "Vladimir Nabokov"},
    {"They wanted facts. Facts! They demanded facts from him, as if facts could explain anything.", "", "Lord Jim", "Joseph Conrad"},
    {"Even the tiny children went and did their best among the leaves and broken branches.", "", "Lord of the Flies", "William Golding"},
    {"“No, not rich,” he said. “I am a poor man with money, which is not the same thing.”", "", "Love in the Time of Cholera", "Gabriel García Márquez"},
    {"She wanted to die. And she wanted to live in Paris.", "", "Madame Bovary", "Gustave Flaubert"},
    {"He who can, does. He who cannot, teaches.", "", "Man and Superman", "George Bernard Shaw"},
    {"Better sleep with a sober cannibal than a drunken Christian.", "", "Moby-Dick", "Herman Melville"},
    {"History has a habit of changing the people who think they are changing it.", "", "Mort", "Terry Pratchett"},
    {"Case fell into the prison of his own flesh.", "", "Neuromancer", "William Gibson"},
    {"WAR IS PEACE, FREEDOM IS SLAVERY, IGNORANCE IS STRENGTH.", "", "Nineteen Eighty-Four", "George Orwell"},
    {"No man really knows about other human beings. The best he can do is to suppose that they are like himself.", "", "Of Mice and Men", "John Steinbeck"},
    {"Whither goest thou, America, in thy shiny car in the night?", "", "On the Road", "Jack Kerouac"},
    {"Races condemned to one hundred years of solitude did not have a second opportunity on earth.", "", "One Hundred Years of Solitude", "Gabriel García Márquez"},
    {"I think like a genius, I write like a distinguished author, I speak like a child.", "", "Pale Fire", "Vladimir Nabokov"},
    {"Better to reign in Hell, than serve in Heaven.", "", "Paradise Lost", "John Milton"},
    {"En skulde aldrig ha’ sine bedste buxer på, når en er ude og strider for frihed og sandhed.", "", "Peer Gynt", "Henrik Ibsen"},
    {"To live would be an awfully big adventure!", "", "Peter Pan", "J. M. Barrie"},
    {"For what do we live, but to make sport for our neighbours, and laugh at them in our turn?", "", "Pride and Prejudice", "Jane Austen"},
    {"All our discontents about what we want appeared to me to spring from the want of thankfulness for what we have.", "", "Robinson Crusoe", "Daniel Defoe"},
    {"Shyness is only the effect of a sense of inferiority in some way or other.", "", "Sense and Sensibility", "Jane Austen"},
    {"When I saw those freshly shaved faces, it was a shock.", "", "Slaughterhouse-Five", "Kurt Vonnegut"},
    {"Creators aren't gods. They make places, which is quite hard. It's men that make gods. This explains a lot.", "", "Small Gods", "Terry Pratchett"},
    {"Juanita's going to hire him, right? — he slams the button for LAVATORY GRANDE ROYALE.", "", "Snow Crash", "Neal Stephenson"},
    {"Harry, the thinker, is a hundred years old, but Harry, the dancer, is scarcely half a day old.", "", "Steppenwolf", "Hermann Hesse"},
    {"A prude is a person who thinks that his own rules of propriety are natural laws.", "", "Stranger in a Strange Land", "Robert A. Heinlein"},
    {"The sage wears coarse clothing over his shoulders, but carries jade within his bosom.", "", "Tao Te Ching", "Laozi"},
    {"Sometimes it is harder to deprive oneself of a pain than of a pleasure.", "", "Tender Is the Night", "F. Scott Fitzgerald"},
    {"If you tell the truth you don't have to remember anything.", "", "The Adventures of Huckleberry Finn", "Mark Twain"},
    {"That’s just like a girl—they’re so thin-skinned and chicken-hearted.", "", "The Adventures of Tom Sawyer", "Mark Twain"},
    {"Tell your heart that the fear of suffering is worse than the suffering itself.", "", "The Alchemist", "Paulo Coelho"},
    {"Victorious warriors win first and then go to war, while defeated warriors go to war first and then seek to win.", "", "The Art of War", "Sun Tzu"},
    {"To the person in the bell jar, blank and stopped as a dead baby, the world itself is the bad dream.", "", "The Bell Jar", "Sylvia Plath"},
    {"I see their ugly and their beauty, and I wonder how the same thing can be both.", "", "The Book Thief", "Markus Zusak"},
    {"The smyler with the knyf under the cloke.", "", "The Canterbury Tales", "Geoffrey Chaucer"},
    {"Anyway, I keep picturing all these little kids playing some game in this big field of rye and all.", "", "The Catcher in the Rye", "J. D. Salinger"},
    {"\"If you had felt yourself sufficient, it would have been a proof that you were not.\"", "", "The Chronicles of Narnia", "C. S. Lewis"},
    {"\"The sum of all human wisdom will be contained in these two words: Wait and hope.\"", "", "The Count of Monte Cristo", "Alexandre Dumas"},
    {"How wonderful it is that no one has to wait, but can start right now to gradually change the world!", "", "The Diary of a Young Girl", "Anne Frank"},
    {"Suffering is dysfunctional, except as a bodily warning against danger.", "", "The Dispossessed", "Ursula K. Le Guin"},
    {"Nel mezzo del cammin di nostra vita, mi ritrovai per una selva oscura, ché la diritta via era smarrita.", "", "The Divine Comedy", "Dante Alighieri"},
    {"New lovers are nervous and tender, but smash everything.", "", "The English Patient", "Michael Ondaatje"},
    {"That's a thing about pain. It demands to be felt.", "", "The Fault in Our Stars", "John Green"},
    {"If everything's the same, then there aren't any choices! I want to wake up in the morning and decide things!", "", "The Giver", "Lois Lowry"},
    {"They longed for philosophy, for synthesis.", "", "The Glass Bead Game", "Hermann Hesse"},
    {"You know how they end yet you listen as though you don't.", "", "The God of Small Things", "Arundhati Roy"},
    {"It happens that every man in a bank hates what the bank does, and yet the bank does it.", "", "The Grapes of Wrath", "John Steinbeck"},
    {"Gatsby believed in the green light, the orgastic future that year by year recedes before us.", "", "The Great Gatsby", "F. Scott Fitzgerald"},
    {"On no account allow a Vogon to read poetry at you.", "", "The Hitchhiker's Guide to the Galaxy", "Douglas Adams"},
    {"In a hole in the ground there lived a hobbit.", "", "The Hobbit", "J. R. R. Tolkien"},
    {"The students crowded into the window, saluted them as they passed with sarcasms and ironical applause.", "", "The Hunchback of Notre-Dame", "Victor Hugo"},
    {"Even a little tedious after more than twenty years.", "", "The Hunger Games", "Suzanne Collins"},
    {"Laila: Tell your secrets to the wind but don't blame it for telling the trees.", "", "The Kite Runner", "Khaled Hosseini"},
    {"I belong to an unlucky generation, astride between two worlds and ill-at-ease in both.", "", "The Leopard", "Giuseppe Tomasi di Lampedusa"},
    {"You become responsible, forever, for what you have tamed.", "", "The Little Prince", "Antoine de Saint-Exupéry"},
    {"We develop only by going against opposition and facing our shadow.", "", "The Lord of the Rings", "J. R. R. Tolkien"},
    {"They knew how to blend art into their living.", "", "The Martian Chronicles", "Ray Bradbury"},
    {"There is in Fantastica a certain place from which one can go anywhere and which can be reached from anywhere.", "", "The Neverending Story", "Michael Ende"},
    {"The clearest view of a man is from below.", "", "The Odyssey", "Homer"},
    {"After this, there was another time which was more painful.", "", "The Once and Future King", "T. H. White"},
    {"You see things. You keep quiet about them. And you understand. You're a wallflower.", "", "The Perks of Being a Wallflower", "Stephen Chbosky"},
    {"Many of the things which can never be, often are.", "", "The Phantom Tollbooth", "Norton Juster"},
    {"Those who go beneath the surface do so at their peril.", "", "The Picture of Dorian Gray", "Oscar Wilde"},
    {"They are gone and I am left and they have taken with them the world.", "", "The Road", "Cormac McCarthy"},
    {"I have laughed, in bitterness and agony of heart, at the contrast between what I seem and what I am!", "", "The Scarlet Letter", "Nathaniel Hawthorne"},
    {"I've stolen a garden. But it may already be dead, I don't know.", "", "The Secret Garden", "Frances Hodgson Burnett"},
    {"Fools talk, cowards are silent, wise men listen.", "", "The Shadow of the Wind", "Carlos Ruiz Zafón"},
    {"Nothing to do but bitch at his wife and nag at the kids and drink.", "", "The Shining", "Stephen King"},
    {"The human race is but a monotonous affair.", "", "The Sorrows of Young Werther", "Johann Wolfgang von Goethe"},
    {"Adrenaline boiled through his body, and his eyes felt as if they were in danger of popping from his head.", "", "The Stand", "Stephen King"},
    {"Ceaseless as the interminable voices of the bell-cricket, all night till dawn my tears flow.", "", "The Tale of Genji", "Murasaki Shikibu"},
    {"There is no intelligence where there is no change and no need of change.", "", "The Time Machine", "H. G. Wells"},
    {"Human history becomes more and more a race between education and catastrophe...", "", "The War of the Worlds", "H. G. Wells"},
    {"The Mole had been working very hard all the morning, spring-cleaning his little home.", "", "The Wind in the Willows", "Kenneth Grahame"},
    {"The world is like a Mask dancing. If you want to see it well, you do not stand in one place.", "", "Things Fall Apart", "Chinua Achebe"},
    {"\"Besides, if I'm only a sort of thing in his dream, what are you, I should like to know?\" \"Ditto\" said Tweedledum.", "", "Through the Looking-Glass", "Lewis Carroll"},
    {"To travel hopefully is a better thing than to arrive.", "", "Treasure Island", "Robert Louis Stevenson"},
    {"A man of genius makes no mistakes. His errors are volitional and are the portals to discovery.", "", "Ulysses", "James Joyce"},
    {"Mother is the name for God in the lips and hearts of little children.", "", "Vanity Fair", "William Makepeace Thackeray"},
    {"Every word is like an unnecessary stain on silence and nothingness.", "", "Waiting for Godot", "Samuel Beckett"},
    {"If a man does not keep pace with his companions, perhaps it is because he hears a different drummer.", "", "Walden", "Henry David Thoreau"},
    {"Peace without Justice is a low estate,— A coward cringing to an iron Fate!", "", "War and Peace", "Leo Tolstoy"},
    {"He’s just a boy pretending to be a wolf. Pretending to be a king.", "", "Where the Wild Things Are", "Maurice Sendak"},
    {"It was just as if somebody inside him were saying, \"Now then, Pooh, time for a little something.\"", "", "Winnie-the-Pooh", "A. A. Milne"},
    {"Be with me always — take any form — drive me mad!", "", "Wuthering Heights", "Emily Brontë"},
    {"Wife; children; house; everything. The full catastrophe.", "", "Zorba the Greek", "Nikos Kazantzakis"},
    {"I do believe that I shall have another of these savories.", "", "A Confederacy of Dunces", "John Kennedy Toole"},
    {"Death destroys a man, but the idea of death saves him.", "", "A Passage to India", "E. M. Forster"},
    {"To live, to err, to fall, to triumph, to recreate life out of life!", "", "A Portrait of the Artist as a Young Man", "James Joyce"},
    {"Luck is believing you're lucky, that's all...", "", "A Streetcar Named Desire", "Tennessee Williams"},
    {"Is it not love that knows how to make smooth things rough and rough things smooth?", "", "A Suitable Boy", "Vikram Seth"},
    {"An infinite question is often destroyed by finite answers.", "", "A Wrinkle in Time", "Madeleine L'Engle"},
    {"You know you say that things are 'much of a muchness' — did you ever see a drawing of a muchness?", "", "Alice's Adventures in Wonderland", "Lewis Carroll"},
    {"Chicago happened slowly, like a migraine.", "", "American Gods", "Neil Gaiman"},
    {"We teach girls to shrink themselves, to make themselves smaller.", "", "Americanah", "Chimamanda Ngozi Adichie"},
    {"All men are enemies. All animals are comrades.", "", "Animal Farm", "George Orwell"},
    {"It showed him the mistake men make in picturing to themselves happiness as the realization of their desires.", "", "Anna Karenina", "Leo Tolstoy"},
    {"I pity the people who aren't born yet for missing it.", "", "Anne of Green Gables", "L. M. Montgomery"},
    {"A man shut up between four walls soon loses the power to associate words and ideas together.", "", "Around the World in Eighty Days", "Jules Verne"},
    {"The spoiler meant to snatch away from the high hall some of human race.", "", "Beowulf", "Anonymous"},
    {"All progressions from a higher to a lower order are marked by ruins and mystery and a residue of nameless rage.", "", "Blood Meridian", "Cormac McCarthy"},
    {"The World State's motto: COMMUNITY, IDENTITY, STABILITY.", "", "Brave New World", "Aldous Huxley"},
    {"Manners are especially the need of the plain. The pretty can get away with anything.", "", "Brideshead Revisited", "Evelyn Waugh"},
    {"In this country it is found requisite, now and then, to put an admiral to death, in order to encourage the others.", "", "Candide", "Voltaire"},
    {"Beware of the man who works hard to learn something, learns it, and finds himself no wiser than before.", "", "Cat's Cradle", "Kurt Vonnegut"},
    {"The colonel had really been investigated.", "", "Catch-22", "Joseph Heller"},
    {"It is not often that someone comes along who is a true friend and a good writer.", "", "Charlotte's Web", "E. B. White"},
    {"We–by whom I mean anyone over sixty—commit two offenses just by existing.", "", "Cloud Atlas", "David Mitchell"},
    {"Lying is man's only privilege over all other organisms.", "", "Crime and Punishment", "Fyodor Dostoevsky"},
    {"The sergeant's widow told you a lie when she said I flogged her. I never flogged her. She flogged herself.", "", "Dead Souls", "Nikolai Gogol"},
    {"The only thing you got in this world is what you can sell.", "", "Death of a Salesman", "Arthur Miller"},
    {"Could he with reason murmur at his case, Himself sole author of his own disgrace?", "", "Disgrace", "J. M. Coetzee"},
    {"It did not seem possible that Wendy Wright had been born out of blood and internal organs like other people.", "", "Do Androids Dream of Electric Sheep?", "Philip K. Dick"},
    {"A bird in the hand is worth two in the bush.", "", "Don Quixote", "Miguel de Cervantes"},
    {"If you are on the floor of a valley, you cannot see beyond your valley.", "", "Dune", "Frank Herbert"},
    {"I have to win this now, and for all time, or I'll fight it every day and it will get worse and worse.", "", "Ender's Game", "Orson Scott Card"},
    {"The books are to remind us what asses and fools we are.", "", "Fahrenheit 451", "Ray Bradbury"},
    {"\"At the store, they have 100% recycled toilet paper,\" Marla says.", "", "Fight Club", "Chuck Palahniuk"},
    {"There was a glamor to it, a perfection and a completeness and a symmetry to it like Grecian art.", "", "Gone with the Wind", "Margaret Mitchell"},
    {"Kids! Bringing about Armageddon can be dangerous. Do not attempt it in your own home.", "", "Good Omens", "Terry Pratchett and Neil Gaiman"},
    {"Poor Nations are hungry, and rich Nations are proud, and Pride and Hunger will ever be at Variance.", "", "Gulliver's Travels", "Jonathan Swift"},
    {"Education is a priority! How can we resist exploitation if we don’t have the tools to understand exploitation?", "", "Half of a Yellow Sun", "Chimamanda Ngozi Adichie"},
    {"Fear of a name increases fear of the thing itself.", "", "Harry Potter and the Philosopher's Stone", "J. K. Rowling"},
    {"I don’t go looking for trouble. Trouble usually finds me!", "", "Harry Potter and the Prisoner of Azkaban", "J. K. Rowling"},
    {"Droll thing life is — that mysterious arrangement of merciless logic for a futile purpose.", "", "Heart of Darkness", "Joseph Conrad"},
    {"I can’t choose my nature, but I can choose what I do.", "", "His Dark Materials", "Philip Pullman"},
    {"As if the perception of the animalesque regression was clear to all.", "Interviewer", "If This Is a Man", "Primo Levi"},
    {"Who knows but that, on the lower frequencies, I speak for you?", "", "Invisible Man", "Ralph Ellison"},
    {"He made me love him without looking at me.", "", "Jane Eyre", "Charlotte Brontë"},
    {"Anyone who falls in love is searching for missing pieces of themselves.", "", "Kafka on the Shore", "Haruki Murakami"},
    {"A morning-glory at my window satisfies me more than the metaphysics of books.", "", "Leaves of Grass", "Walt Whitman"},
    {"Life is so beautiful that death has fallen in love with it, a jealous, possessive love that grabs at what it can.", "", "Life of Pi", "Yann Martel"},
    {"Love is the only thing that we can carry with us when we go, and it makes the end so easy.", "", "Little Women", "Louisa May Alcott"},
    {"You can always count on a murderer for a fancy prose style.", "", "Lolita", "Vladimir Nabokov"},
    {"The real significance of crime is in its being a breach of faith with the community of mankind.", "", "Lord Jim", "Joseph Conrad"},
    {"His voice was lower when he spoke again.", "", "Lord of the Flies", "William Golding"},
    {"\"I adore you because you made me a whore\"", "", "Love in the Time of Cholera", "Gabriel García Márquez"},
    {"The future was a pitch-black tunnel, ending in a locked door.", "", "Madame Bovary", "Gustave Flaubert"},
    {"Hell is full of musical amateurs. Music is the brandy of the damned.", "", "Man and Superman", "George Bernard Shaw"},
    {"Talk not to me of blasphemy, man; I'd strike the sun if it insulted me.", "", "Moby-Dick", "Herman Melville"},
    {"It struck Mort with sudden, terrible poignancy that Death must be the loneliest creature in the universe.", "", "Mort", "Terry Pratchett"},
    {"Somewhere down in the Sprawl's ferro-concrete roots, a train drove a column of stale air through a tunnel.", "", "Neuromancer", "William Gibson"},
    {"There will be no curiosity, no enjoyment of the process of life.", "", "Nineteen Eighty-Four", "George Orwell"},
    {"Not courting talk — real straight talk about souls, for life is holy and every moment is precious.", "", "On the Road", "Jack Kerouac"},
    {"The world was reduced to the surface of her skin and her inner self was safe from all bitterness.", "", "One Hundred Years of Solitude", "Gabriel García Márquez"},
    {"Curiosity is insubordination in its purest form.", "", "Pale Fire", "Vladimir Nabokov"},
    {"All is not lost; th’ unconquerable will, And study of revenge, immortal hate, And courage never to submit or yield.", "", "Paradise Lost", "John Milton"},
    {"If I might so put it, it's an agreement for the mutual forgiveness of sin.", "", "Peer Gynt", "Henrik Ibsen"},
    {"\"I'm youth, I'm joy, I'm a little bird that has broken out of the egg.\"", "", "Peter Pan", "J. M. Barrie"},
    {"It is better to have a lion at the head of an army of sheep than a sheep at the head of an army of lions.", "", "Robinson Crusoe", "Daniel Defoe"},
    {"All there is to say about a massacre, things like \"Poo-tee-weet?\"", "", "Slaughterhouse-Five", "Kurt Vonnegut"},
    {"Rumor is information distilled so finely that it can filter through anything.", "", "Small Gods", "Terry Pratchett"},
    {"The world is full of power and energy and a person can go far by just skimming off a tiny bit of it.", "", "Snow Crash", "Neal Stephenson"},
    {"I am going to teach you to dance and play and smile, and still not be happy.", "", "Steppenwolf", "Hermann Hesse"},
    {"Obscurity is the refuge of the incompetent.", "", "Stranger in a Strange Land", "Robert A. Heinlein"},
    {"He who is satisfied with his lot is rich; he who goes on acting with energy has a (firm) will.", "", "Tao Te Ching", "Laozi"},
    {"\"The strongest guard is placed at the gateway to nothing,\" he said.", "", "Tender Is the Night", "F. Scott Fitzgerald"},
    {"Reader, suppose you were an idiot. And suppose you were a member of Congress. But I repeat myself.", "", "The Adventures of Huckleberry Finn", "Mark Twain"},
    {"“Now I know you’ll tell me,” said the lady.", "", "The Adventures of Tom Sawyer", "Mark Twain"},
    {"“Because, wherever your heart is, that is where you’ll find your treasure.”", "", "The Alchemist", "Paulo Coelho"},
    {"Attack him where he is unprepared, appear where you are not expected.", "", "The Art of War", "Sun Tzu"},
    {"Our kind multiplies:We shall by morning Inherit the earth.", "", "The Bell Jar", "Sylvia Plath"},
    {"He collected her punches as if they were presents.", "", "The Book Thief", "Markus Zusak"},
    {"Gret swering is a thing abhominable, And false swering is yet more reprevable.", "", "The Canterbury Tales", "Geoffrey Chaucer"},
    {"I'm the most terrific liar you ever saw in your life.", "", "The Catcher in the Rye", "J. D. Salinger"},
    {"It didn't say this as if it were boasting, nor as if it were sorry, nor as if it were angry.", "", "The Chronicles of Narnia", "C. S. Lewis"},
    {"He who has felt the deepest grief is best able to experience supreme happiness.", "", "The Count of Monte Cristo", "Alexandre Dumas"},
    {"At such moments I don't think about all the misery, but about the beauty that still remains.", "", "The Diary of a Young Girl", "Anne Frank"},
    {"You must go somewhere else; you must have another goal; then you walk a different road.", "", "The Dispossessed", "Ursula K. Le Guin"},
    {"Superbia, invidia e avarizia sono le tre faville c'hanno i cuori accesi.", "", "The Divine Comedy", "Dante Alighieri"},
